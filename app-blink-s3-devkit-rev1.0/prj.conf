## prj.conf
```kconfig
# Needed to control the internal RGB LED of the Espressif ESP32s3-WROOM-1-N8R2 on GPIO38
CONFIG_SPI=y
CONFIG_LED_STRIP=y
CONFIG_LOG=y
```

## src/main.cpp
```c
#include <zephyr/device.h>
#include <zephyr/drivers/led_strip.h>
#include <zephyr/kernel.h>
#include <zephyr/logging/log.h>

#define SLEEP_TIME_MS 1000

// The devicetree node identifier for the "led0" alias.
#define STRIP_NODE DT_ALIAS(led_strip)

LOG_MODULE_REGISTER(main, LOG_LEVEL_INF);

static const struct device *const strip = DEVICE_DT_GET(STRIP_NODE);

int main(void) {
  if (!device_is_ready(strip)) {
    LOG_ERR("LED strip not ready");
    return 0;
  }

  struct led_rgb colors[3] = {
      {.r = 0x10, .g = 0x00, .b = 0x00}, // red
      {.r = 0x00, .g = 0x00, .b = 0x10}, // blue
      {.r = 0x00, .g = 0x00, .b = 0x00}, // off
  };
  int idx = 0;

  while (1) {
    // Apply to the rgb led red, blue, off order as blinking pattern
    int ret = led_strip_update_rgb(strip, &colors[idx], 1);
    LOG_INF("idx=%d ret=%d", idx, ret);
    idx = (idx + 1) % 3;
    k_msleep(SLEEP_TIME_MS);
  }

  return 0;
}
```
