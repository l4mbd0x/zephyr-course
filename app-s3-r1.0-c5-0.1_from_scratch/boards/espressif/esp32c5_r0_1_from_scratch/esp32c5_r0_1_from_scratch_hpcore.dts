/*
 * Copyright (c) 2026 Espressif Systems (Shanghai) Co., Ltd.
 *
 * SPDX-License-Identifier: Apache-2.0
 */

/dts-v1/;

#include <espressif/esp32c5/esp32c5_wroom_n8r4.dtsi>
#include "esp32c5_r0_1_from_scratch_hpcore-pinctrl.dtsi"
#include <espressif/partitions_0x2000_default_8M.dtsi>

/ {
	model = "Espressif ESP32C5-DevKitC-1 HP Core";
	compatible = "espressif,esp32c5";

	chosen {
		zephyr,sram = &sramhp;
		zephyr,console = &uart0;
		zephyr,shell-uart = &uart0;
		zephyr,flash = &flash0;
		zephyr,code-partition = &slot0_partition;
	};
};

&uart0 {
	status = "okay";
	current-speed = <115200>;
	pinctrl-0 = <&uart0_default>;
	pinctrl-names = "default";
};

&gpio0 {
	status = "okay";
};
