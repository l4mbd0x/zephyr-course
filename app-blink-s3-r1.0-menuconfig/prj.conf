## CMakeLists.txt
```
cmake_minimum_required(VERSION 3.20.0)

find_package(Zephyr REQUIRED)
project(app-blink-s3-wroom-1-n8r2-devkitc-rev1.0-menuconfig)

target_sources(app PRIVATE src/main.cpp)
```

## prj.conf
```kconfig
#CONFIG_GPIO=y
# Needed to control the internal RGB LED of the Espressif ESP32s3-WROOM-1-N8R2 on GPIO38
CONFIG_SPI=y
CONFIG_LED_STRIP=y
CONFIG_LOG=y
```

## src/main.cpp
```c
#include <zephyr/device.h>
#include <zephyr/drivers/led_strip.h>
#include <zephyr/kernel.h>
#include <zephyr/logging/log.h>

LOG_MODULE_REGISTER(main, LOG_LEVEL_INF);

int main(void) {

  while (1) {}

  return 0;
}
```
