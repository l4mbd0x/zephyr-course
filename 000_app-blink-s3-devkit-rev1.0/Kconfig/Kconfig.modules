## 000_app-blink-s3-devkit-rev1.0/Kconfig/Kconfig.modules
```kconfig
menu "cmsis_6 (C:/Users/Nicol/Projects/git-repos/Other_projects/westWorkspace/deps/modules/hal/cmsis_6)"
osource "$(ZEPHYR_CMSIS_6_KCONFIG)"
config ZEPHYR_CMSIS_6_MODULE
	bool
	default y
endmenu
menu "hal_espressif (C:/Users/Nicol/Projects/git-repos/Other_projects/westWorkspace/deps/modules/hal/espressif)"
osource "C:/Users/Nicol/Projects/git-repos/Other_projects/westWorkspace/deps/modules/hal/espressif/zephyr/Kconfig"
config ZEPHYR_HAL_ESPRESSIF_MODULE
	bool
	default y

config ZEPHYR_HAL_ESPRESSIF_MODULE_BLOBS
	bool
endmenu
```

## 000_app-blink-s3-devkit-rev1.0/Kconfig/arch/Kconfig
```kconfig
# Load Zephyr Arch Kconfig descriptions.
osource "C:/Users/Nicol/Projects/git-repos/Other_projects/westWorkspace/deps/zephyr/arch/rx/Kconfig"
osource "C:/Users/Nicol/Projects/git-repos/Other_projects/westWorkspace/deps/zephyr/arch/x86/Kconfig"
osource "C:/Users/Nicol/Projects/git-repos/Other_projects/westWorkspace/deps/zephyr/arch/xtensa/Kconfig"
osource "C:/Users/Nicol/Projects/git-repos/Other_projects/westWorkspace/deps/zephyr/arch/sparc/Kconfig"
osource "C:/Users/Nicol/Projects/git-repos/Other_projects/westWorkspace/deps/zephyr/arch/riscv/Kconfig"
osource "C:/Users/Nicol/Projects/git-repos/Other_projects/westWorkspace/deps/zephyr/arch/posix/Kconfig"
osource "C:/Users/Nicol/Projects/git-repos/Other_projects/westWorkspace/deps/zephyr/arch/mips/Kconfig"
osource "C:/Users/Nicol/Projects/git-repos/Other_projects/westWorkspace/deps/zephyr/arch/arm64/Kconfig"
osource "C:/Users/Nicol/Projects/git-repos/Other_projects/westWorkspace/deps/zephyr/arch/arm/Kconfig"
osource "C:/Users/Nicol/Projects/git-repos/Other_projects/westWorkspace/deps/zephyr/arch/arc/Kconfig"
```

## 000_app-blink-s3-devkit-rev1.0/Kconfig/boards/Kconfig
```kconfig
# Load Zephyr board Kconfig descriptions.
osource "C:/Users/Nicol/Projects/git-repos/Other_projects/westWorkspace/deps/zephyr/boards/espressif/esp32s3_devkitc/Kconfig"
```

## app-blink-s3-r1.0-kconfig/Kconfig
```kconfig
config BLINK_SLEEP_TIME_MS
    int "prompt led"
    default 1000
    range 100 5000
    help
        Test 1

source "Kconfig.zephyr"
```

## app-s3-r1.0-c5-0.1_custom/boards/espressif/my_esp32c5-r0.1/Kconfig.my_esp32c5_r0_1
```kconfig
# ESP32C5 devkitc board configuration

# Copyright (c) 2026 Espressif Systems (Shanghai) Co., Ltd.
# SPDX-License-Identifier: Apache-2.0

config BOARD_MY_ESP32C5_R0_1
	select SOC_ESP32_C5_WROOM_1_N8R4
	select SOC_ESP32C5_HPCORE if BOARD_MY_ESP32C5_R0_1_ESP32C5_HPCORE
	select SOC_ESP32C5_LPCORE if BOARD_MY_ESP32C5_R0_1_ESP32C5_LPCORE
```

## app-s3-r1.0-c5-0.1_custom/boards/espressif/my_esp32c5-r0.1/board.yml
```yaml
board:
  name: my_esp32c5_r0_1
  full_name: ESP32-C5-DevKitC-1 rev 0.1 
  vendor: espressif
  socs:
  - name: esp32c5
```

## app-s3-r1.0-c5-0.1_from_scratch/boards/espressif/esp32c5_r0_1_from_scratch/Kconfig.esp32c5_r0_1_from_scratch
```kconfig
# ESP32C5 devkitc board configuration

# Copyright (c) 2026 Espressif Systems (Shanghai) Co., Ltd.
# SPDX-License-Identifier: Apache-2.0

config BOARD_ESP32C5_R0_1_FROM_SCRATCH
	select SOC_ESP32_C5_WROOM_1_N8R4
	select SOC_ESP32C5_HPCORE if BOARD_ESP32C5_R0_1_FROM_SCRATCH_ESP32C5_HPCORE
```

## past_assignments/app-blink-s3-r1.0-kconfig-choice/Kconfig
```kconfig
choice 
    prompt "LED blink speed"
    default BLINK_SLEEP_1000MS

    config BLINK_SLEEP_200MS
        bool "Fast"
        
    config BLINK_SLEEP_1000MS
        bool "Normal"

    config BLINK_SLEEP_2000MS
        bool "SLOW"

endchoice

config BLINK_SLEEP_TIME_MS
    int
    default 200 if BLINK_SLEEP_200MS
    default 1000 if BLINK_SLEEP_1000MS
    default 2000 if BLINK_SLEEP_2000MS
    default 0

source "Kconfig.zephyr"
```

## past_assignments/app-blink-s3-r1.0-menuconfig/Kconfig
```kconfig
menuconfig LED_SUBSYSTEM
    bool "LED Subsystem"
    default y

if LED_SUBSYSTEM

    menu "LED blink sleep time (1s (medium))"

        choice 
            prompt "LED blink speed"
            default BLINK_SLEEP_1000MS

            config BLINK_SLEEP_250MS
                bool "Faster"
                
            config BLINK_SLEEP_500MS
                bool "Fast"

            config BLINK_SLEEP_1000MS
                bool "Normal"

            config BLINK_SLEEP_2000MS
                bool "SLOW"

        endchoice

        config BLINK_SLEEP_TIME_MS
            int
            default 250 if BLINK_SLEEP_250MS
            default 500 if BLINK_SLEEP_500MS
            default 1000 if BLINK_SLEEP_1000MS
            default 2000 if BLINK_SLEEP_2000MS
            default 0

    endmenu
    
    menuconfig ADVANCED_LED_SETTINGS
        bool "Advanced LED settings"
        default n
        
        config LED_BRIGHTNESS
            int "LED brightness (0-100)"
            default 100
            range 0 100
        
        config LED_FADE_DURATION
            int "LED fade duration (ms)"
            default 500
            range 0 5000

        menu "Expert settings"
            visible if ADVANCED_LED_SETTINGS

            config ENABLE_LED_DEBUGGING
                bool "Enable LED debugging"
                default n

            config CUSTOM_BLINK_PATTERN
                bool "Custom blink pattern"
                default n
        
        endmenu

endif # LED_SUBSYSTEM


source "Kconfig.zephyr"
```

## past_assignments/app-heartbeat-s3-r1.0-dts/Kconfig
```kconfig
config APP_HEARTBEAT_PERIOD_MS
    int "Led heartbeat period (ms)"
    default 500
    range 100 2000
    help
        Period between heartbeat LED state updates, in milliseconds.

source "Kconfig.zephyr"
```
